## main/Kconfig.creds
```kconfig
menu "Wifi Credentials"
config "WIFI_NAME"
	string "Verizon_NM3HXK"
	default "myssid"
config "WIFI_PW"
	string "con3-jag-local"
	default "mypass"
endmenu
```

## main/Kconfig.projbuild
```kconfig
menu "Wifi Credentials"
config WIFI_NAME
	string "wifi_name"
	default "myssid"
config WIFI_PW
	string "wifi_password"
	default "mypass"
endmenu
```
